## firmware/camera_test/main/Kconfig.projbuild
```kconfig
menu "Camera Test Configuration"

    config WIFI_SSID
        string "WiFi SSID"
        default "your_wifi_ssid"
        help
            SSID of the WiFi network to connect to.

    config WIFI_PASSWORD
        string "WiFi Password"
        default "your_wifi_password"
        help
            Password for the WiFi network.

endmenu
```

## firmware/camera_test/sdkconfig.defaults
```kconfig
# Target
CONFIG_IDF_TARGET="esp32s3"

# Flash — board has 16MB
CONFIG_ESPTOOLPY_FLASHSIZE_16MB=y
CONFIG_ESPTOOLPY_FLASHSIZE="16MB"

# PSRAM — octal, 80 MHz (required for camera + inference)
CONFIG_ESP32S3_SPIRAM_SUPPORT=y
CONFIG_SPIRAM_MODE_OCT=y
CONFIG_SPIRAM_SPEED_80M=y
CONFIG_SPIRAM_MALLOC_ALWAYSINTERNAL=16384

# CPU: 240 MHz
CONFIG_ESP32S3_DEFAULT_CPU_FREQ_240=y

# Camera
CONFIG_CAMERA_MODULE_ESP_S3_EYE=y

# WiFi
CONFIG_ESP_WIFI_STATIC_RX_BUFFER_NUM=16
CONFIG_ESP_WIFI_DYNAMIC_RX_BUFFER_NUM=64
CONFIG_ESP_WIFI_TX_BUFFER=DYNAMIC
CONFIG_ESP_WIFI_DYNAMIC_TX_BUFFER_NUM=64

# HTTP server — larger buffers for MJPEG
CONFIG_HTTPD_MAX_RESP_HDR_LEN=1024
CONFIG_HTTPD_MAX_URI_LEN=512

# Stack sizes
CONFIG_ESP_MAIN_TASK_STACK_SIZE=8192
```
